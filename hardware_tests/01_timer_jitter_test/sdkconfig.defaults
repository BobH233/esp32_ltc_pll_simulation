## hardware_tests/01_timer_jitter_test/sdkconfig.defaults
```kconfig
# ESP32-S3 Timer Jitter Test 配置

# 目标芯片
CONFIG_IDF_TARGET="esp32s3"

# CPU频率设置（最大性能）
CONFIG_ESP_DEFAULT_CPU_FREQ_MHZ_240=y
CONFIG_ESP_DEFAULT_CPU_FREQ_MHZ=240

# FreeRTOS优化
CONFIG_FREERTOS_HZ=1000
CONFIG_FREERTOS_USE_TICKLESS_IDLE=n

# 禁用WiFi和蓝牙（减少干扰）
CONFIG_ESP_WIFI_ENABLED=n
CONFIG_BT_ENABLED=n

# 高精度定时器配置
CONFIG_ESP_TIMER_PROFILING=y
CONFIG_ESP_TIMER_TASK_STACK_SIZE=4096

# 编译优化
CONFIG_COMPILER_OPTIMIZATION_PERF=y

# 日志级别
CONFIG_LOG_DEFAULT_LEVEL_INFO=y
CONFIG_LOG_MAXIMUM_LEVEL_VERBOSE=y

# 看门狗（测试时可以禁用）
CONFIG_ESP_TASK_WDT_EN=n
CONFIG_ESP_INT_WDT=n

# Flash优化
CONFIG_ESPTOOLPY_FLASHMODE_QIO=y
CONFIG_ESPTOOLPY_FLASHFREQ_80M=y
```

## hardware_tests/01_timer_jitter_test_pio/sdkconfig.defaults
```kconfig
# ESP32-S3 Timer Jitter Test - ESP-IDF Configuration
# 此文件覆盖默认的 sdkconfig 设置，优化定时器性能

# ==================== 芯片配置 ====================
CONFIG_IDF_TARGET="esp32s3"

# ==================== PSRAM 配置 ====================
# ESP32-S3-N16R8 有 8MB OPI PSRAM
CONFIG_ESP32S3_SPIRAM_SUPPORT=y
CONFIG_SPIRAM_MODE_OCT=y
CONFIG_SPIRAM_TYPE_ESPPSRAM64=y
CONFIG_SPIRAM=y
CONFIG_SPIRAM_SPEED_80M=y
CONFIG_SPIRAM_USE_MALLOC=y

# ==================== CPU 配置 ====================
CONFIG_ESP_DEFAULT_CPU_FREQ_MHZ_240=y
CONFIG_ESP_DEFAULT_CPU_FREQ_MHZ=240

# ==================== FreeRTOS 配置 ====================
CONFIG_FREERTOS_HZ=1000
CONFIG_FREERTOS_USE_TICKLESS_IDLE=n

# ==================== 禁用 WiFi/BT（减少干扰）====================
CONFIG_ESP_WIFI_ENABLED=n
CONFIG_BT_ENABLED=n

# ==================== 禁用看门狗（测试期间）====================
CONFIG_ESP_TASK_WDT_EN=n
CONFIG_ESP_INT_WDT=n

# ==================== 高精度定时器 ====================
CONFIG_ESP_TIMER_PROFILING=y
CONFIG_ESP_TIMER_TASK_STACK_SIZE=4096

# ==================== 编译优化 ====================
CONFIG_COMPILER_OPTIMIZATION_PERF=y

# ==================== 日志级别 ====================
CONFIG_LOG_DEFAULT_LEVEL_INFO=y
CONFIG_LOG_MAXIMUM_LEVEL_VERBOSE=y

# ==================== Flash 优化 ====================
CONFIG_ESPTOOLPY_FLASHMODE_QIO=y
CONFIG_ESPTOOLPY_FLASHFREQ_80M=y
```
